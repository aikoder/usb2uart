## prj.conf
```kconfig
# enable SEGGER LOG
CONFIG_LOG=y
CONFIG_USE_SEGGER_RTT=y
CONFIG_LOG_BACKEND_RTT=y
CONFIG_LOG_PRINTK=y

CONFIG_BOARD_HAS_NRF5_BOOTLOADER=n
```

## src/main.c
```c
/*
 * Copyright (c) 2012-2014 Wind River Systems, Inc.
 *
 * SPDX-License-Identifier: Apache-2.0
 */

#include <zephyr/kernel.h>

void main(void)
{
	printk("Hello World! %s\n", CONFIG_BOARD);

	while (1)
	{
		printk("Hello World! %s\n", CONFIG_BOARD);
		k_msleep(1000);
	}
}
```
